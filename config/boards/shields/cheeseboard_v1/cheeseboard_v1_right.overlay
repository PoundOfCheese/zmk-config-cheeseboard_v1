#include "cheeseboard_v1.dtsi" // Notice that the main dtsi files are included in the overlay.

&transform_base { // The matrix transform for this board is 7 columns over because the left half is 7 columns wide according to the matrix.
    col-offset = <8>;
};

&kscan0 {
    row-gpios
        = <&pro_micro 7 (GPIO_ACTIVE_HIGH | GPIO_PULL_DOWN)> // Row 0 from the schematic file
        , <&pro_micro 8 (GPIO_ACTIVE_HIGH | GPIO_PULL_DOWN)> // Row 1 from the schematic file
        , <&pro_micro 15 (GPIO_ACTIVE_HIGH | GPIO_PULL_DOWN)> // Row 2 from the schematic file
        , <&pro_micro 14 (GPIO_ACTIVE_HIGH | GPIO_PULL_DOWN)> // Row 3 from the schematic file
        , <&pro_micro 16 (GPIO_ACTIVE_HIGH | GPIO_PULL_DOWN)> // Row 4 from the schematic file
        , <&pro_micro 10 (GPIO_ACTIVE_HIGH | GPIO_PULL_DOWN)> // Row 5 from the schematic file
        ;
    
    col-gpios
        = <&pro_micro 2 GPIO_ACTIVE_HIGH> // col0 in the schematic
        , <&pro_micro 3 GPIO_ACTIVE_HIGH> // col1 in the schematic
        , <&pro_micro 4 GPIO_ACTIVE_HIGH> //  col2 in the schematic
        , <&pro_micro 5 GPIO_ACTIVE_HIGH> //  col3 in the schematic
        , <&pro_micro 6 GPIO_ACTIVE_HIGH> // col4 in the schematic
        , <&pro_micro 18 GPIO_ACTIVE_HIGH> // col5 in the schematic
        , <&pro_micro 19 GPIO_ACTIVE_HIGH> // col6 in the schematic
        , <&pro_micro 20 GPIO_ACTIVE_HIGH> // col7 in the schematic
        , <&pro_micro 9 GPIO_ACTIVE_HIGH> // col8 in the schematic
        ;
};
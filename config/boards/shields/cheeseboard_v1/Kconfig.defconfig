## config/boards/shields/cheeseboard_v1/Kconfig.defconfig
```kconfig
if SHIELD_CHEESEBOARD_V1_LEFT

config ZMK_KEYBOARD_NAME
    default "Cheeseboard v1"

config ZMK_SPLIT_ROLE_CENTRAL
    default y

endif

if SHIELD_CHEESEBOARD_V1_LEFT || SHIELD_CHEESEBOARD_V1_RIGHT

config ZMK_SPLIT
    default y

endif
```

## config/west.yml
```yaml
manifest:
  remotes:
    - name: zmkfirmware
      url-base: https://github.com/zmkfirmware
    - name: nguyendown
      url-base: https://github.com/nguyendown
    # Additional modules containing boards/shields/custom code can be listed here as well
    # See https://docs.zephyrproject.org/3.2.0/develop/west/manifest.html#projects
  projects:
    - name: zmk
      remote: zmkfirmware
      revision: v0.2.1
      import: app/west.yml
    - name: zmk-behavior-socd
      remote: nguyendown
      revision: main
  self:
    path: config
```
